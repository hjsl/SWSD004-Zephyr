## project/boards/arm/semtech_lr1110trk1bks/Kconfig.board
```kconfig
# STM32WB55RG Nucleo board configuration

# Copyright (c) 2019 Linaro Limited
# SPDX-License-Identifier: Apache-2.0

config BOARD_SEMTECH_LR1110TRK1BKS
	bool "Semtech LR1110TRK1BKS Lora Edge Tracker Reference Design"
	depends on SOC_STM32WB55XX
```

## project/boards/arm/semtech_lr1110trk1bks/Kconfig.defconfig
```kconfig
# LR1110TRK1BKS board configuration

if BOARD_SEMTECH_LR1110TRK1BKS

config BOARD
	default "semtech_lr1110trk1bks"

choice BT_HCI_BUS_TYPE
	default BT_STM32_IPM
	depends on BT
endchoice

# LPTIM clocked by LSE, force tick freq to 4096 for tick accuracy
config SYS_CLOCK_TICKS_PER_SEC
	default 4096 if STM32_LPTIM_TIMER

endif # BOARD_SEMTECH_LR1110TRK1BKS
```

## project/boards/arm/semtech_lr1110trk1bks/dts/bindings/psemi,pe4259.yaml
```yaml
description: |
  SPDT High Power UltraCMOS 10MHz–3.0GHz RF Switch.

compatible: "psemi,pe4259"

include: [base.yaml, power.yaml]

properties:
  ctrl-gpios:
    type: phandle-array
    required: true
    description: Pin used to control the RF switch
```
